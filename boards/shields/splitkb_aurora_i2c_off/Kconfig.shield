## boards/shields/splitkb_aurora_i2c_off/Kconfig.shield
```kconfig
# SPDX-License-Identifier: MIT

config SHIELD_SPLITKB_AURORA_I2C_OFF
    def_bool $(shields_list_contains,splitkb_aurora_i2c_off)
```

## boards/shields/splitkb_nice_view_spi/Kconfig.shield
```kconfig
# SPDX-License-Identifier: MIT

config SHIELD_SPLITKB_NICE_VIEW_SPI
    def_bool $(shields_list_contains,splitkb_nice_view_spi)
```
