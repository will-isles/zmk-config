/*
 * SPDX-License-Identifier: MIT
 *
 * Merged last: splitkb_aurora_corne.dtsi enables SSD1306 on &pro_micro_i2c,
 * which shares HW with SPI0 on nRF52840. nice!view uses SPI; disable I2C0.
 */

&i2c0 {
    status = "disabled";
};

&pro_micro_i2c {
    status = "disabled";
};
